## boards/SakuGlumoff/iida_devkit/iida_devkit_defconfig
```kconfig
CONFIG_GPIO=y
CONFIG_I2C=y
CONFIG_SENSOR=y
CONFIG_FLASH=y
CONFIG_EEPROM=y
CONFIG_FUEL_GAUGE=y

CONFIG_SERIAL=y
CONFIG_CONSOLE=y
CONFIG_UART_CONSOLE=y
CONFIG_UART_LINE_CTRL=y
CONFIG_UART_INTERRUPT_DRIVEN=y
CONFIG_USB_DEVICE_STACK_NEXT=y
CONFIG_CDC_ACM_SERIAL_INITIALIZE_AT_BOOT=y

# Use STMicroelectronics vendor ID
CONFIG_CDC_ACM_SERIAL_VID=0x0483
# Use a random product ID
CONFIG_CDC_ACM_SERIAL_PID=0x0001
CONFIG_CDC_ACM_SERIAL_PRODUCT_STRING="Iida devkit"

CONFIG_HW_STACK_PROTECTION=y
```
